#define COMPOSITE_PIN 14


#define SWIDTH 64
#define SHEIGHT 262
#define SLENGTH 16700 // a little fudged


int screenStart = SWIDTH * 20 + 10;
volatile int frameCount = 0;

// Define your picture directly in program memory using the provided bitmap data
const unsigned char PROGMEM bitmap_jzxl2r[] = {
  0x80,0x00,0x00,0x00,0x00,0x00,0x00,0x00,0x00,0x00,0x00,0x00,0x00,0x00,0x00,0x00,
  0x80,0x00,0x00,0x00,0x00,0x00,0x00,0x00,0x00,0x00,0x00,0x00,0x00,0x00,0x00,0x00,
  0x80,0x00,0x00,0x00,0x00,0x00,0x00,0x00,0x00,0x00,0x00,0x00,0x00,0x00,0x00,0x00,
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  0x80,0x00,0x00,0x00,0x00,0x00,0x00,0x00,0x00,0x00,0x00,0x00,0x00,0x00,0x00,0x00
};


#define JZXL2R_BMPWIDTH  128
#define JZXL2R_BMPHEIGHT 64

// Adjust the width and height to match the bitmap dimensions
#define WIDTH  JZXL2R_BMPWIDTH
#define HEIGHT JZXL2R_BMPHEIGHT

uint8_t screenBuffer[WIDTH * HEIGHT]; // Define a screen buffer to hold the image

void setupBuffer() {
  // Copy the bitmap data into the screen buffer
  for (int i = 0; i < WIDTH * HEIGHT; i++) {
    screenBuffer[i] = pgm_read_byte(&bitmap_jzxl2r[i]);
  }
}

uint8_t vsync(int x, int y) {
  if (y < 9) {
    // 9 pulse lines:
    // 6 pre equalizing pulses
    // 6 sync pulses
    // 6 post equalizing pulses
    int pulse = y/3 % 2;
    int pulseDelay = pulse ? 4 : 2;
    int hx = x / 2;
    if (hx < pulseDelay) {
      return pulse ? 1 : 0;
    }
    else {
      return pulse ? 0 : 1;
    }
  }
  else {
    // 11 black lines
    return x < 5 ? 0 : 1;
  }
}

uint8_t halfline(int x) {
  return x < 6 ? 1 : 0;
}

uint8_t scanline(int x, int y) {
  if (x < 5) {
    // sync
    return 0;
  }
  else if(x < 10) {
    // back porch
    return 1;
  }
  else if(x < 62) {
    return drawBuffer(x, y);
  }
  else {
    return 1;
  }
}

void setupBuffer2() {
  for(int i=0; i<SLENGTH; i++) {
    int x = i % SWIDTH;
    int y = i / SWIDTH;
    if (y < 20) {
      screenBuffer[i] = vsync(x, y);
    }
    else if(y < SHEIGHT-1) {
      screenBuffer[i] = scanline(x, y);
    }
    else {
      screenBuffer[i] = halfline(x);
    }
  }
}

uint8_t drawBuffer(int x, int y) {
  // x value starts at sample 10, y value starts at line 20
  int i = x - 10;
  int j = y - 20;

  // Calculate the luminance based on the frame count (time)
  uint8_t luminance = min(255, frameCount); // Limit luminance to 255
  uint8_t pixel = pgm_read_byte(&screenBuffer[i % WIDTH + j % HEIGHT * WIDTH]);
  
  // Increase the luminance of the pixel over time
  return min(255, pixel + luminance);
}

void writeComposite(uint8_t v) {
  // Output the composite signal to COMPOSITE_PIN
  // Here, we'll assume a simple encoding where a higher luminance value corresponds to a higher voltage level on the pin.

  // Scale the luminance value to the range of 0-255 to match the analogWrite() function
  int outputValue = map(v, 0, 255, 0, 255);

  // Output the composite signal
  analogWrite(COMPOSITE_PIN, outputValue);
}


void setup() {
  pinMode(COMPOSITE_PIN, OUTPUT);
  setupBuffer();
}

void loop() {
  elapsedMicros ts;
  while(1) {
    writeComposite(screenBuffer[ts]);
    frameCount++;
    if (ts >= SLENGTH) {
      ts = 0;
    }
  }
}
